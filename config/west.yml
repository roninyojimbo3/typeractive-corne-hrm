## config/west.yml
```yaml
manifest:
  remotes:
    - name: zmkfirmware
      url-base: https://github.com/zmkfirmware
    - name: roninyojimbo3
      url-base: https://github.com/roninyojimbo3

  projects:
    - name: zmk
      remote: zmkfirmware
      revision: v0.3
      import: app/west.yml
    - name: nice-view-mod
      remote: roninyojimbo3
      revision: main

  self:
    path: config
```
